## layers/meta-resin-raspberrypi/conf/machine/revpi-core-3.conf
```bitbake
#@TYPE: Machine
#@NAME: Revolution Pi Core 3
#@DESCRIPTION: Machine configuration for Revolution Pi Core 3 board

MACHINEOVERRIDES = "raspberrypi3:${MACHINE}"
include conf/machine/raspberrypi3.conf

PREFERRED_PROVIDER_virtual/kernel = "linux-kunbus"

KERNEL_DEVICETREE_append = " \
	overlays/kunbus.dtbo \
"

KERNEL_MODULE_AUTOLOAD += "piControl"
```
