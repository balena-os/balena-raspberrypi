## layers/meta-dkms/conf/layer.conf
```bitbake
BBPATH .= ":${LAYERDIR}"
BBFILES += "${LAYERDIR}/recipes-*/*/*.bb ${LAYERDIR}/recipes-*/*/*.bbappend"
BBFILE_COLLECTIONS += "meta-dkms"
BBFILE_PATTERN_meta-dkms = "^${LAYERDIR}/"
LAYERSERIES_COMPAT_meta-dkms = "kirkstone scarthgap"
```
