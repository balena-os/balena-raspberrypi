## layers/meta-audit/conf/layer.conf
```bitbake
BBPATH .= ":${LAYERDIR}"
BBFILES += "${LAYERDIR}/recipes-*/*/*.bb ${LAYERDIR}/recipes-*/*/*.bbappend"
BBFILE_COLLECTIONS += "meta-audit"
BBFILE_PATTERN_meta-audit = "^${LAYERDIR}/"
LAYERSERIES_COMPAT_meta-audit = "kirkstone scarthgap"
```

## layers/meta-balena-raspberrypi/conf/layer.conf
```bitbake
BBPATH .= ":${LAYERDIR}"

BBFILES += "${LAYERDIR}/recipes-*/*/*.bb \
            ${LAYERDIR}/recipes-*/*/*.bbappend"

BBFILE_COLLECTIONS += "balena-raspberrypi"
BBFILE_PATTERN_balena-raspberrypi := "^${LAYERDIR}/"
BBFILE_PRIORITY_balena-raspberrypi = "1337"

LAYERSERIES_COMPAT_balena-raspberrypi = "scarthgap"

# As per https://github.com/balena-os/meta-balena/pull/2411
# we only do this for the Pi3-64 Pi4-64, which don't have
# enough rootfs space for the Honister update.
FULL_OPTIMIZATION:raspberrypi4-64 = "-Os -pipe ${DEBUG_FLAGS}"
FULL_OPTIMIZATION:raspberrypi3-64 = "-Os -pipe ${DEBUG_FLAGS}"

KERNEL_DEVICETREE:append:fincm3 = " overlays/balena-fin.dtbo"
KERNEL_DEVICETREE:append:fincm3 = " overlays/spyfly.dtbo"

KERNEL_DEVICETREE:append:npe-x500-m3 = " overlays/npe-x500-m3.dtbo"

# Helps switch SPI function block to GPIOs 40-45 during HUP
# for updating boot EEPROM on RPI4
KERNEL_DEVICETREE:append:raspberrypi4-64 = " overlays/spi-gpio40-45.dtbo"

# the Revolution Pi boards are on an older kernel release which does not have the following overlays
KERNEL_DEVICETREE:remove:revpi = "overlays/hifiberry-amp4pro.dtbo"
KERNEL_DEVICETREE:remove:revpi = "overlays/uart0-pi5.dtbo"
KERNEL_DEVICETREE:remove:revpi = "overlays/uart1-pi5.dtbo"
KERNEL_DEVICETREE:remove:revpi = "overlays/uart2-pi5.dtbo"
KERNEL_DEVICETREE:remove:revpi = "overlays/uart3-pi5.dtbo"
KERNEL_DEVICETREE:remove:revpi = "overlays/uart4-pi5.dtbo"
KERNEL_DEVICETREE:remove:revpi = "overlays/vc4-kms-v3d-pi5.dtbo"
KERNEL_DEVICETREE:remove:revpi = "overlays/vc4-kms-dsi-ili9881-7inch.dtbo"
KERNEL_DEVICETREE:remove:revpi = "overlays/bcm2712d0.dtbo"

# We use udev rules to create serial device aliases
SERIAL_CONSOLES = "115200;serial0"

# we should clean up all the following RPI_KERNEL_DEVICETREE changes when we switch to a newer meta-raspberrypi which contains a 6.x kernel
RPI_KERNEL_DEVICETREE ?= " \
    broadcom/bcm2708-rpi-zero.dtb \
    broadcom/bcm2708-rpi-zero-w.dtb \
    broadcom/bcm2708-rpi-b.dtb \
    broadcom/bcm2708-rpi-b-rev1.dtb \
    broadcom/bcm2708-rpi-b-plus.dtb \
    broadcom/bcm2709-rpi-2-b.dtb \
    broadcom/bcm2710-rpi-2-b.dtb \
    broadcom/bcm2710-rpi-3-b.dtb \
    broadcom/bcm2710-rpi-3-b-plus.dtb \
    broadcom/bcm2710-rpi-zero-2.dtb \
    broadcom/bcm2711-rpi-4-b.dtb \
    broadcom/bcm2711-rpi-400.dtb \
    broadcom/bcm2708-rpi-cm.dtb \
    broadcom/bcm2710-rpi-cm3.dtb \
    broadcom/bcm2711-rpi-cm4.dtb \
    broadcom/bcm2711-rpi-cm4s.dtb \
"

RPI_KERNEL_DEVICETREE:append:raspberrypi5 = " broadcom/bcm2712d0-rpi-5-b.dtb"
RPI_KERNEL_DEVICETREE:append:raspberrypi5 = " broadcom/bcm2712-rpi-500.dtb"
RPI_KERNEL_DEVICETREE:append:raspberrypi5 = " broadcom/bcm2712-rpi-cm5-cm4io.dtb"
RPI_KERNEL_DEVICETREE:append:raspberrypi5 = " broadcom/bcm2712-rpi-cm5-cm5io.dtb"
RPI_KERNEL_DEVICETREE:append:raspberrypi5 = " broadcom/bcm2712-rpi-cm5l-cm4io.dtb"
RPI_KERNEL_DEVICETREE:append:raspberrypi5 = " broadcom/bcm2712-rpi-cm5l-cm5io.dtb"

PREFERRED_VERSION_linux-raspberrypi = "6.12%"
# This is set to 6.1 in meta-raspberrypi's machine/raspberrypi5.conf
# and needs an explicit device override here to take effect
PREFERRED_VERSION_linux-raspberrypi:raspberrypi5 = "6.12%"

# Use the full version of cyfmac43455-sdio firmware to support WPA3
CYFMAC43455_SDIO_FIRMWARE = "standard"

FIRMWARE_COMPRESSION:raspberrypi4-64 ?= "1"
FIRMWARE_COMPRESSION:raspberrypi0-2w-64 ?= "1"

# avoid pseudo abort due to iwlwifi firmware being cleaned outside of fakeroot - this should be a temporary workaround until https://github.com/balena-os/meta-balena/pull/2270 is merged
IWLWIFI_FW_TOCLEAN:raspberrypi4-64 = ""
IWLWIFI_FW_TOCLEAN:raspberrypi0-2w-64 = ""

KERNEL_FEATURES:remove:revpi-core-3 = "cfg/fs/vfat.scc"
KERNEL_FEATURES:remove:revpi-connect = "cfg/fs/vfat.scc"
KERNEL_FEATURES:remove:revpi-connect-s = "cfg/fs/vfat.scc"
KERNEL_FEATURES:remove:revpi-connect-4 = "cfg/fs/vfat.scc"

VC4DTBO = "vc4-kms-v3d,cma-320"
```

## layers/meta-balena-raspberrypi/conf/machine/fincm3.conf
```bitbake
#@TYPE: Machine
#@NAME: Balena Fin (CM3)
#@DESCRIPTION: Machine configuration for Balena Fin board (CM3)

MACHINEOVERRIDES = "raspberrypi3:${MACHINE}"
include conf/machine/raspberrypi3.conf

MACHINE_ESSENTIAL_EXTRA_RRECOMMENDS += "sd8887-nxp"
```

## layers/meta-balena-raspberrypi/conf/machine/include/revpi.inc
```bitbake
MACHINEOVERRIDES =. "raspberrypi3:"
include conf/machine/raspberrypi3.conf

SOC_FAMILY = "rpi:revpi"

PREFERRED_PROVIDER_virtual/kernel = "linux-kunbus"

KERNEL_MODULE_AUTOLOAD += "piControl"

IMAGE_INSTALL:append = " picontrol"

# to have KBUILD_DEFCONFIG correctly overridden for all revpi based devices we need to define it for the machine type we base upon
KBUILD_DEFCONFIG:raspberrypi3 = "revpi-v7_defconfig"
```

## layers/meta-balena-raspberrypi/conf/machine/include/revpi4.inc
```bitbake
MACHINEOVERRIDES =. "raspberrypi4-64:"
include conf/machine/raspberrypi4-64.conf

SOC_FAMILY = "rpi:revpi"

PREFERRED_PROVIDER_virtual/kernel = "linux-kunbus"

KERNEL_MODULE_AUTOLOAD += "piControl"

IMAGE_INSTALL:append = " picontrol"

# to have KBUILD_DEFCONFIG correctly overridden for all revpi4 based devices we need to define it for the machine type we base upon
KBUILD_DEFCONFIG:raspberrypi4-64 = "revpi-v8_defconfig"
```

## layers/meta-balena-raspberrypi/conf/machine/nebra-hnt.conf
```bitbake
#@TYPE: Machine
#@NAME: Raspberry Pi 3 64 bits
#@DESCRIPTION: Machine configuration for Raspberry Pi 3 64 bits 

MACHINEOVERRIDES =. "raspberrypi3-64:"
include conf/machine/raspberrypi3-64.conf

# Use this version until it's updated in poky,
# to test the pending upstream patches
PREFERRED_VERSION_bluez5 = "5.56"
```

## layers/meta-balena-raspberrypi/conf/machine/raspberrypi4-edatec-sensing.conf
```bitbake
#@TYPE: Machine
#@NAME: EDATEC CM4 Sensing
#@DESCRIPTION: Machine configuration for EDATEC CM4 Sensing Board

MACHINEOVERRIDES =. "raspberrypi4-64:"
include conf/machine/raspberrypi4-64.conf
```

## layers/meta-balena-raspberrypi/conf/machine/raspberrypi4-superhub.conf
```bitbake
#@TYPE: Machine
#@NAME: Raspberrypi4 SuperHub Gateway
#@DESCRIPTION: Machine configuration for Raspberrypi4 SuperHub Gateway Board

MACHINEOVERRIDES =. "raspberrypi4-64:"
include conf/machine/raspberrypi4-64.conf
```

## layers/meta-balena-raspberrypi/conf/machine/raspberrypi400-64.conf
```bitbake
#@TYPE: Machine
#@NAME: Raspberrypi400-64
#@DESCRIPTION: Machine configuration for Raspberrypi400

MACHINEOVERRIDES =. "raspberrypi4-64:"
include conf/machine/raspberrypi4-64.conf
```

## layers/meta-balena-raspberrypi/conf/machine/raspberrypicm4-ioboard-sb.conf
```bitbake
#@TYPE: Machine
#@NAME: RaspberrypiCM4-IOBoard-SB
#@DESCRIPTION: Machine configuration for SB/FDE Raspberrypi Compute Module 4 IO Board

MACHINEOVERRIDES =. "raspberrypi4-64:"
include conf/machine/raspberrypi4-64.conf

BALENA_NONENC_BOOT_LABEL = "balena-rpi"
```

## layers/meta-balena-raspberrypi/conf/machine/raspberrypicm4-ioboard.conf
```bitbake
#@TYPE: Machine
#@NAME: RaspberrypiCM4-IOBoard
#@DESCRIPTION: Machine configuration for Raspberrypi Compute Module 4 IO Board

MACHINEOVERRIDES =. "raspberrypi4-64:"
include conf/machine/raspberrypi4-64.conf
```

## layers/meta-balena-raspberrypi/conf/machine/revpi-connect-4.conf
```bitbake
#@TYPE: Machine
#@NAME: Revolution Pi Connect 4
#@DESCRIPTION: Machine configuration for Revolution Pi Connect 4 board

require conf/machine/include/revpi4.inc

KERNEL_DEVICETREE:append = " \
	overlays/revpi-connect4.dtbo \
	overlays/revpi-dt-blob-overlay.dtb \
"
```

## layers/meta-balena-raspberrypi/conf/machine/revpi-connect.conf
```bitbake
#@TYPE: Machine
#@NAME: Revolution Pi Connect
#@DESCRIPTION: Machine configuration for Revolution Pi Connect board

require conf/machine/include/revpi.inc

KERNEL_DEVICETREE:append = " \
	overlays/revpi-connect.dtbo \
	overlays/revpi-connect-dt-blob-overlay.dtb \
	overlays/revpi-connect-can.dtbo \
"
```

## layers/meta-balena-raspberrypi/conf/machine/revpi-core-3.conf
```bitbake
#@TYPE: Machine
#@NAME: Revolution Pi Core 3
#@DESCRIPTION: Machine configuration for Revolution Pi Core 3 board

require conf/machine/include/revpi.inc

KERNEL_DEVICETREE:append = " \
	overlays/revpi-core.dtbo \
	overlays/revpi-core-dt-blob-overlay.dtb \
"
```

## layers/meta-balena-raspberrypi/conf/machine/revpi-core-se.conf
```bitbake
#@TYPE: Machine
#@NAME: Revolution Pi Core SE
#@DESCRIPTION: Machine configuration for Revolution Pi Core SE board

require conf/machine/include/revpi4.inc

KERNEL_DEVICETREE:append = " \
	overlays/revpi-core.dtbo \
	overlays/revpi-core-dt-blob-overlay.dtb \
    overlays/revpi-core-se-2022-overlay.dtb \
"
```

## layers/meta-balena-raspberrypi/conf/machine/rt-rpi-300.conf
```bitbake
#@TYPE: Machine
#@NAME: Rocktech-RPI-300
#@DESCRIPTION: Machine configuration for Rocktech-RPI-300

MACHINEOVERRIDES =. "raspberrypi4-64:"

include conf/machine/raspberrypi4-64.conf

PREFERRED_VERSION_linux-raspberrypi = "5.15.%"
```

## layers/meta-balena-raspberrypi/conf/machine/test-private.conf
```bitbake
#@TYPE: Machine
##@NAME: test-private
##@DESCRIPTION: Machine configuration for an extra configured genericx86-64 device


MACHINEOVERRIDES = "raspberrypi3:${MACHINE}"
include conf/machine/raspberrypi3.conf

# FIRMWARE_COMPRESSION ?= "1"

# MACHINE_FEATURES += " efi raid"
```

## layers/meta-balena-raspberrypi/conf/machine/unipi-neuron.conf
```bitbake
#@TYPE: Machine
#@NAME: UniPi Neuron
#@DESCRIPTION: Machine configuration for UniPi Neuron boards

MACHINEOVERRIDES = "raspberrypi3:${MACHINE}"
include conf/machine/raspberrypi3.conf

IMAGE_INSTALL_append = " unipi-kernel-modules unipi-tools"
```

## layers/meta-debug/conf/layer.conf
```bitbake
BBPATH .= ":${LAYERDIR}"
BBFILES += "${LAYERDIR}/recipes-*/*/*.bb ${LAYERDIR}/recipes-*/*/*.bbappend"
BBFILE_COLLECTIONS += "meta-debug"
BBFILE_PATTERN_meta-debug = "^${LAYERDIR}/"
LAYERSERIES_COMPAT_meta-debug = "kirkstone scarthgap"
```

## layers/meta-kernel-block/conf/layer.conf
```bitbake
BBPATH .= ":${LAYERDIR}"
BBFILES += "${LAYERDIR}/recipes-*/*/*.bb ${LAYERDIR}/recipes-*/*/*.bbappend"
BBFILE_COLLECTIONS += "meta-kernel-block"
BBFILE_PATTERN_meta-kernel-block = "^${LAYERDIR}/"
LAYERSERIES_COMPAT_meta-kernel-block = "kirkstone scarthgap"
```

## layers/meta-kernel-modules-block/conf/layer.conf
```bitbake
BBPATH .= ":${LAYERDIR}"
BBFILES += "${LAYERDIR}/recipes-*/*/*.bb ${LAYERDIR}/recipes-*/*/*.bbappend"
BBFILE_COLLECTIONS += "meta-kernel-modules-block"
BBFILE_PATTERN_meta-kernel-modules-block = "^${LAYERDIR}/"
LAYERSERIES_COMPAT_meta-kernel-modules-block = "kirkstone scarthgap"
```

## layers/meta-resin-raspberrypi/conf/layer.conf
```bitbake
BBPATH .= ":${LAYERDIR}"

BBFILES += "${LAYERDIR}/recipes-*/*/*.bb \
            ${LAYERDIR}/recipes-*/*/*.bbappend"

BBFILE_COLLECTIONS += "resin-raspberrypi"
BBFILE_PATTERN_resin-raspberrypi := "^${LAYERDIR}/"
BBFILE_PRIORITY_resin-raspberrypi = "1337"

LAYERSERIES_COMPAT_resin-raspberrypi = "sumo"

# Add all the overlays available in kernel source code
#
# The files below come from kernel-source/arch/arm/boot/dts/overlays/, but without
# the ones already defined in meta-raspberrypi/conf/machine/include/rpi-base.inc.
# They have been renamed to match rpi-base.inc.
KERNEL_DEVICETREE_append = " \
    overlays/adau1977-adc.dtbo \
    overlays/adau7002-simple.dtbo \
    overlays/ads1015.dtbo \
    overlays/ads1115.dtbo \
    overlays/ads7846.dtbo \
    overlays/akkordion-iqdacplus.dtbo \
    overlays/allo-boss-dac-pcm512x-audio.dtbo \
    overlays/allo-digione.dtbo \
    overlays/allo-piano-dac-pcm512x-audio.dtbo \
    overlays/allo-piano-dac-plus-pcm512x-audio.dtbo \
    overlays/at86rf233.dtbo \
    overlays/audioinjector-addons.dtbo \
    overlays/audioinjector-wm8731-audio.dtbo \
    overlays/audremap.dtbo \
    overlays/bmp085_i2c-sensor.dtbo \
    overlays/dht11.dtbo \
    overlays/dionaudio-loco.dtbo \
    overlays/dionaudio-loco-v2.dtbo \
    overlays/dpi18.dtbo \
    overlays/dpi24.dtbo \
    overlays/dwc2.dtbo \
    overlays/dwc-otg.dtbo \
    overlays/enc28j60.dtbo \
    overlays/enc28j60-spi2.dtbo \
    overlays/fe-pi-audio.dtbo \
    overlays/goodix.dtbo \
    overlays/googlevoicehat-soundcard.dtbo \
    overlays/gpio-ir.dtbo \
    overlays/gpio-poweroff.dtbo \
    overlays/gpio-shutdown.dtbo \
    overlays/hifiberry-digi-pro.dtbo \
    overlays/hy28a.dtbo \
    overlays/hy28b.dtbo \
    overlays/i2c0-bcm2708.dtbo \
    overlays/i2c1-bcm2708.dtbo \
    overlays/i2c-bcm2708.dtbo \
    overlays/i2c-gpio.dtbo \
    overlays/i2c-mux.dtbo \
    overlays/i2c-pwm-pca9685a.dtbo \
    overlays/i2c-rtc-gpio.dtbo \
    overlays/i2c-sensor.dtbo \
    overlays/i2s-gpio28-31.dtbo \
    overlays/iqaudio-digi-wm8804-audio.dtbo \
    overlays/justboom-dac.dtbo \
    overlays/justboom-digi.dtbo \
    overlays/mcp23017.dtbo \
    overlays/mcp23s17.dtbo \
    overlays/mcp2515-can0.dtbo \
    overlays/mcp2515-can1.dtbo \
    overlays/mcp3008.dtbo \
    overlays/midi-uart0.dtbo \
    overlays/midi-uart1.dtbo \
    overlays/mmc.dtbo \
    overlays/mpu6050.dtbo \
    overlays/mz61581.dtbo \
    overlays/papirus.dtbo \
    overlays/pi3-act-led.dtbo \
    overlays/pi3-disable-wifi.dtbo \
    overlays/piscreen2r.dtbo \
    overlays/piscreen.dtbo \
    overlays/pisound.dtbo \
    overlays/pitft28-capacitive.dtbo \
    overlays/pwm-2chan.dtbo \
    overlays/pwm.dtbo \
    overlays/qca7000.dtbo \
    overlays/rotary-encoder.dtbo \
    overlays/rpi-backlight.dtbo \
    overlays/rpi-cirrus-wm5102.dtbo \
    overlays/rpi-dac.dtbo \
    overlays/rpi-display.dtbo \
    overlays/rpi-proto.dtbo \
    overlays/rpi-sense.dtbo \
    overlays/rpi-tv.dtbo \
    overlays/rra-digidac1-wm8741-audio.dtbo \
    overlays/sc16is750-i2c.dtbo \
    overlays/sc16is752-spi1.dtbo \
    overlays/sdhost.dtbo \
    overlays/sdio-1bit.dtbo \
    overlays/sdio.dtbo \
    overlays/sdtweak.dtbo \
    overlays/smi-dev.dtbo \
    overlays/smi.dtbo \
    overlays/smi-nand.dtbo \
    overlays/spi0-cs.dtbo \
    overlays/spi0-hw-cs.dtbo \
    overlays/spi1-1cs.dtbo \
    overlays/spi1-2cs.dtbo \
    overlays/spi1-3cs.dtbo \
    overlays/spi2-1cs.dtbo \
    overlays/spi2-2cs.dtbo \
    overlays/spi2-3cs.dtbo \
    overlays/spi-gpio35-39.dtbo \
    overlays/spi-rtc.dtbo \
    overlays/tinylcd35.dtbo \
    overlays/uart1.dtbo \
    overlays/vc4-fkms-v3d.dtbo \
    overlays/vga666.dtbo \
    overlays/wittypi.dtbo \
"

KERNEL_DEVICETREE_append = " overlays/balena-fin.dtbo"

# We use udev rules to create serial device aliases
SERIAL_CONSOLE = "115200 serial0"
```

## layers/meta-resin-raspberrypi/conf/machine/fincm3.conf
```bitbake
#@TYPE: Machine
#@NAME: Balena Fin (CM3)
#@DESCRIPTION: Machine configuration for Balena Fin board (CM3)

MACHINEOVERRIDES = "raspberrypi3:${MACHINE}"
include conf/machine/raspberrypi3.conf
```

## layers/meta-resin-raspberrypi/conf/machine/npe-x500-m3.conf
```bitbake
#@TYPE: Machine
#@NAME: NPE X500 M3 (CM3)
#@DESCRIPTION: Machine configuration for NPE X500 M3 board (CM3)

MACHINEOVERRIDES = "raspberrypi3:${MACHINE}"
include conf/machine/raspberrypi3.conf
```

## layers/meta-resin-raspberrypi/conf/machine/raspberrypi3.conf
```bitbake
#@TYPE: Machine
#@NAME: RaspberryPi 3 Development Board
#@DESCRIPTION: Machine configuration for the RaspberryPi 3

MACHINEOVERRIDES = "raspberrypi2:${MACHINE}"

KERNEL_DEVICETREE_append = "bcm2710-rpi-3-b.dtb"

include conf/machine/raspberrypi2.conf
```
